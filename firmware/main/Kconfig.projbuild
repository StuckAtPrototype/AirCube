## firmware/main/Kconfig.projbuild
```kconfig
menu "AirCube Configuration"

config AIRCUBE_ZB_TX_POWER_DBM
    int "Zigbee TX power (dBm)"
    range -24 20
    default 20
    help
        Requested Zigbee transmit power in dBm for the native 802.15.4 radio.
        Actual applied power may be clamped by hardware, SDK, or regional limits.
        Default is the chip maximum (20 dBm) for best link margin; reduce if
        you need lower power consumption or to satisfy regional EIRP limits.

endmenu
```

## firmware/sdkconfig.defaults
```kconfig
#
# AirCube default build configuration
#

#
# Target chip
#
CONFIG_IDF_TARGET="esp32h2"

#
# Flash size (AirCube hardware has 2MB flash)
#
CONFIG_ESPTOOLPY_FLASHSIZE_2MB=y
CONFIG_ESPTOOLPY_FLASHSIZE="2MB"

#
# Custom partition table (includes zb_storage, zb_fct, and history partitions)
#
CONFIG_PARTITION_TABLE_CUSTOM=y
CONFIG_PARTITION_TABLE_CUSTOM_FILENAME="partitions_zigbee.csv"
CONFIG_PARTITION_TABLE_FILENAME="partitions_zigbee.csv"

#
# Zigbee (required by firmware/main/zigbee.c)
#
CONFIG_ZB_ENABLED=y
# CONFIG_ZB_ZCZR is not set
CONFIG_ZB_ZED=y
# CONFIG_ZB_ZGPD is not set
CONFIG_ZB_RADIO_NATIVE=y
# CONFIG_ZB_RADIO_SPINEL_UART is not set
CONFIG_AIRCUBE_ZB_TX_POWER_DBM=20

#
# Bluetooth (NimBLE peripheral) — BLE-first radio mode.
# BLE and Zigbee never run simultaneously: radio_mode.c starts exactly one
# stack per boot (BLE by default, Zigbee when commissioned), so software
# coexistence stays OFF. The earlier PHY hang (wait_freq_set_busy) only
# occurred when both the BT coex layer and 802.15.4 were active at once.
#
CONFIG_BT_ENABLED=y
CONFIG_BT_NIMBLE_ENABLED=y
CONFIG_BT_NIMBLE_ROLE_PERIPHERAL=y
CONFIG_BT_NIMBLE_ROLE_BROADCASTER=y
# CONFIG_BT_NIMBLE_ROLE_CENTRAL is not set
# CONFIG_BT_NIMBLE_ROLE_OBSERVER is not set
CONFIG_BT_NIMBLE_MAX_CONNECTIONS=1
# 4 + 32*7 = 228-byte history frames fit one notification at MTU 256
CONFIG_BT_NIMBLE_ATT_PREFERRED_MTU=256
# CONFIG_BT_NIMBLE_SECURITY_ENABLE is not set

#
# Radio coexistence disabled (modes are exclusive by design).
#
# CONFIG_ESP_COEX_SW_COEXIST_ENABLE is not set
```
